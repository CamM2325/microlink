## examples/basic_connect/main/Kconfig.projbuild
```kconfig
menu "Example Configuration"

    config ML_EXAMPLE_TARGET_PEER_IP
        string "Target Peer VPN IP (for sending)"
        default ""
        help
            VPN IP of the peer to send "hello" messages to (e.g., "100.103.181.24").
            Leave empty to only receive (no outgoing messages).
            The peer should run: nc -lu 9000

    config ML_EXAMPLE_LIFECYCLE_CYCLES
        int "Stop/start lifecycle test cycles (0 = disabled)"
        default 0
        range 0 1000
        help
            After the first connection, run this many microlink_stop() /
            microlink_start() cycles before entering the normal loop. The
            cycles rotate through three variants:
              - stop after CONNECTED, then start the same handle
              - stop 3 s after start (mid-registration / MapResponse, so
                the control-plane task is blocked in a socket read)
              - stop + microlink_destroy() + microlink_init() + start
            Each cycle logs "LIFECYCLE n/N" lines with the stop duration and
            free heap; the run ends with "LIFECYCLE RESULT: PASS" or "FAIL".
            Also set CONFIG_LOG_MAXIMUM_LEVEL_DEBUG=y to get an "ml_heap"
            line with the free internal RAM after each teardown step.
            Leave at 0 for normal use.

endmenu
```

## examples/ethernet_connect/main/Kconfig.projbuild
```kconfig
menu "Example Ethernet"

    choice EXAMPLE_ETH_TYPE
        prompt "Ethernet hardware"
        default EXAMPLE_ETH_WT32_ETH01 if IDF_TARGET_ESP32
        default EXAMPLE_ETH_W5500

        config EXAMPLE_ETH_WT32_ETH01
            bool "WT32-ETH01 (ESP32 internal EMAC + LAN8720)"
            depends on IDF_TARGET_ESP32
            select ETH_USE_ESP32_EMAC
        config EXAMPLE_ETH_W5500
            bool "W5500 module over SPI (any ESP32 chip)"
            select ETH_USE_SPI_ETHERNET
            select ETH_SPI_ETHERNET_W5500
        config EXAMPLE_ETH_OPENETH
            bool "QEMU emulated Ethernet (OpenCores MAC)"
            depends on IDF_TARGET_ESP32
            select ETH_USE_OPENETH
    endchoice

    if EXAMPLE_ETH_W5500
        config EXAMPLE_W5500_SCLK
            int "SPI SCLK GPIO"
            default 12
        config EXAMPLE_W5500_MOSI
            int "SPI MOSI GPIO"
            default 11
        config EXAMPLE_W5500_MISO
            int "SPI MISO GPIO"
            default 13
        config EXAMPLE_W5500_CS
            int "SPI CS GPIO"
            default 10
        config EXAMPLE_W5500_INT
            int "Interrupt GPIO (-1 = poll)"
            default 4
            range -1 48
        config EXAMPLE_W5500_SPI_MHZ
            int "SPI clock (MHz)"
            default 20
            range 5 40
    endif

endmenu
```
