## examples/rebind_test/sdkconfig.defaults
```kconfig
# Rebind Test — ESP32-S3 + Cellular PPP
CONFIG_IDF_TARGET="esp32s3"

# PSRAM
CONFIG_SPIRAM=y
CONFIG_SPIRAM_MODE_OCT=y
CONFIG_SPIRAM_SPEED_80M=y
CONFIG_SPIRAM_TRY_ALLOCATE_WIFI_LWIP=y

# Flash
CONFIG_ESPTOOLPY_FLASHSIZE_8MB=y

# lwIP
CONFIG_LWIP_MAX_SOCKETS=16
CONFIG_LWIP_SO_RCVBUF=y
CONFIG_LWIP_TCPIP_RECVMBOX_SIZE=64
CONFIG_LWIP_TCP_SND_BUF_DEFAULT=32768
CONFIG_LWIP_TCP_WND_DEFAULT=32768
CONFIG_LWIP_PPP_SUPPORT=y
CONFIG_LWIP_PPP_PAP_SUPPORT=y
CONFIG_LWIP_PPP_CHAP_SUPPORT=y
CONFIG_LWIP_PPP_ENABLE_IPV6=n
CONFIG_LWIP_PPP_VJ_HEADER_COMPRESSION=n

# mbedTLS
CONFIG_MBEDTLS_CHACHA20_C=y
CONFIG_MBEDTLS_POLY1305_C=y
CONFIG_MBEDTLS_CHACHAPOLY_C=y
CONFIG_MBEDTLS_HKDF_C=y
CONFIG_MBEDTLS_SSL_PROTO_TLS1_2=y

# FreeRTOS
CONFIG_FREERTOS_HZ=1000
CONFIG_FREERTOS_TIMER_TASK_STACK_DEPTH=4096

# CPU
CONFIG_ESP_DEFAULT_CPU_FREQ_MHZ_240=y
CONFIG_ESP_MAIN_TASK_STACK_SIZE=8192
CONFIG_ESP_TASK_WDT_TIMEOUT_S=60

# Partition
CONFIG_PARTITION_TABLE_SINGLE_APP_LARGE=y

# Log
CONFIG_LOG_DEFAULT_LEVEL_INFO=y

# UART
CONFIG_ESP_CONSOLE_UART_NUM=0

# MicroLink cellular
CONFIG_ML_ENABLE_CELLULAR=y
CONFIG_ML_CELLULAR_APN="america.bics"
CONFIG_ML_ENABLE_CONFIG_HTTPD=y
CONFIG_ML_CONFIG_MAX_ALLOWED_PEERS=512
CONFIG_ML_PRIORITY_PEER_IP=""
```
